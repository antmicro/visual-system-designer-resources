/ {
	compatible = "intel,socfpga-agilex5";
	chosen {
		zephyr,console = &uart0;
		zephyr,sram = &mem0;
	};
};
&mdio0{
	csr-clock-indx = < 0x4 >;
};
&uart0{
	status = "okay";
	current-speed = < 0x1c200 >;
};
