/ {
	compatible = "microchip,m2gl025-miv";
	chosen {
		zephyr,console = &uart0;
		zephyr,sram = &sram0;
		zephyr,flash = &flash0;
	};
};
&uart0{
	status = "okay";
	current-speed = < 0x1c200 >;
	clock-frequency = < 0x3ef1480 >;
};
