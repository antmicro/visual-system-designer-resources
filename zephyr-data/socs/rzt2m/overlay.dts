/ {
	compatible = "renesas,rzt2m_starter_kit";
	chosen {
		zephyr,console = &uart0;
		zephyr,sram = &cpu0_atcm;
	};
};
&uart3{
	status = "okay";
	pinctrl-0 = < &uart3_default >;
	pinctrl-names = "default";
};
&uart0{
	status = "okay";
	pinctrl-0 = < &uart0_default >;
	pinctrl-names = "default";
};
