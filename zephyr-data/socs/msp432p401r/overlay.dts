/ {
	compatible = "ti,msp-exp432p401r-launchxl", "ti,msp432p401r", "ti,msp432p4xx";
	chosen {
		zephyr,console = &uart0;
		zephyr,flash = &flash0;
		zephyr,sram = &sram0;
	};
};
&uart0{
	status = "okay";
	current-speed = < 0x1c200 >;
};
