/ {
	compatible = "xlnx,zynqmp-r5";
	chosen {
		zephyr,console = &uart1;
		zephyr,flash = &flash0;
		zephyr,sram = &sram0;
	};
};
&uart0{
	status = "okay";
	current-speed = < 0x1c200 >;
	clock-frequency = < 0x5f5e09d >;
	pinctrl-0 = < &uart0_default >;
	pinctrl-names = "default";
};
&uart1{
	status = "okay";
	current-speed = < 0x1c200 >;
	clock-frequency = < 0x5f5e09d >;
};
