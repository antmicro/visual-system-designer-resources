/ {
	compatible = "nxp,lpc51xxx", "nxp,lpc";
	chosen {
		zephyr,console = &flexcomm0;
		zephyr,sram = &sram0;
		zephyr,flash = &flash0;
	};
};
&sc_timer{
	status = "disabled";
};
&flexcomm0{
	status = "okay";
	current-speed = < 0x1c200 >;
	pinctrl-0 = < &pinmux_flexcomm0_uart >;
	pinctrl-names = "default";
};
