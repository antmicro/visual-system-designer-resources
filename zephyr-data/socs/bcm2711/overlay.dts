/ {
	compatible = "brcm,bcm2838", "raspberrypi,4-model-b";
	chosen {
		zephyr,console = &uart1;
		zephyr,sram = &sram0;
	};
};
&gpio1{
	status = "okay";
};
&uart1{
	status = "okay";
	current-speed = < 0x1c200 >;
};
