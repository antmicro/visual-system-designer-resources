/ {
	compatible = "nxp";
	chosen {
		zephyr,console = &lpuart2;
		zephyr,sram = &sram0;
	};
};
&lpuart2{
	status = "okay";
	current-speed = < 0x1c200 >;
	pinctrl-0 = < &lpuart2_default >;
	pinctrl-names = "default";
};
&sai1{
	pinctrl-0 = < &sai1_default >;
	pinctrl-names = "default";
};
