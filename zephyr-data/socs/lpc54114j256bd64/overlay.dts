/ {
	compatible = "nxp,lpc54xxx", "nxp,lpc";
	chosen {
		zephyr,console = &flexcomm0;
		zephyr,sram = &sram0;
		zephyr,flash = &flash0;
	};
};
&sram0{
	reg = < 0x20000000 0x20000 >;
};
&flexcomm0{
	compatible = "nxp,lpc-usart";
	status = "okay";
	current-speed = < 0x1c200 >;
	pinctrl-0 = < &pinmux_flexcomm0_usart >;
	pinctrl-names = "default";
};
