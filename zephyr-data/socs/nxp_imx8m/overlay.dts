/ {
	compatible = "nxp";
	chosen {
		zephyr,console = &uart4;
		zephyr,sram = &sram0;
	};
};
&uart4{
	status = "okay";
	current-speed = < 0x1c200 >;
	pinctrl-0 = < &uart4_default >;
	pinctrl-names = "default";
};
