/ {
	compatible = "nxp,lpc", "nxp,lpc51xxx";
	chosen {
		zephyr,console = &flexcomm0;
		zephyr,flash = &flash0;
		zephyr,sram = &sram0;
	};
};
&flexcomm0{
	compatible = "nxp,lpc-usart";
	status = "okay";
	current-speed = < 0x1c200 >;
	pinctrl-0 = < &pinmux_flexcomm0_uart >;
	pinctrl-names = "default";
};
