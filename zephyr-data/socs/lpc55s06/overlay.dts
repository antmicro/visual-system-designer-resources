/ {
	compatible = "nxp,lpc", "nxp,lpc55xxx";
	chosen {
		zephyr,console = &flexcomm0;
		zephyr,flash = &flash0;
		zephyr,sram = &sram0;
	};
};
&can0{
	status = "okay";
	pinctrl-0 = < &pinmux_can0 >;
	pinctrl-names = "default";
};
&flexcomm0{
	compatible = "nxp,lpc-usart";
	status = "okay";
	current-speed = < 0x1c200 >;
	pinctrl-0 = < &pinmux_flexcomm0_usart >;
	pinctrl-names = "default";
};
